#include "Include.h"
const uint8_t Example[4][72]=   //����ʵ��
{
	{0x00,0x00,0x00,0x00,0x00,0x00,0x10,0x00,0x00,0x1C,0x00,0x30,0x0E,0xFF,0xF8,0x0E,
0x30,0x70,0x00,0xF0,0x70,0xC1,0xB0,0x70,0x71,0xB8,0xE0,0x3B,0x18,0xE0,0x3B,0x18,
0xE0,0x1F,0x19,0xC0,0x06,0x1D,0xC0,0x06,0x0D,0x80,0x0E,0x0F,0x80,0x0C,0x07,0x00,
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0x80,0xFC,0x1F,0x00,0x38,0x00,0x00,0x00},
};

const uint8_t En_Example[] = "     HAN ZI SHI Li";	//����ʵ��
const uint8_t Point_float[] = "               .";
const uint8_t Num0[] = "0";//0
const uint8_t Num1[] = "1";//1
const uint8_t Num2[] = "2";//2
const uint8_t Num3[] = "3";//3
const uint8_t Num4[] = "4";//4
const uint8_t Num5[] = "5";//5
const uint8_t Num6[] = "6";//6
const uint8_t Num7[] = "7";//7
const uint8_t Num8[] = "8";//8
const uint8_t Num9[] = "9";//9

const uint8_t Yaw_Dis[] = "   Yaw is: ";
const uint8_t Pitch_Dis[] = "   Pitch is: ";
const uint8_t Roll_Dis[] = "   Roll is: ";
const uint8_t Tempr_Dis[] = "   Tempr is: ";
const uint8_t Alt_Dis[] = "   Alt is: ";
const uint8_t Press_Dis[] = "   Press is: ";
const uint8_t F[] = "            -";

void Display_Yaw()
{
	LCD_DisplayStringLine(LCD_LINE_2, (uint8_t *)Yaw_Dis);
}
void Display_Pitch()
{
	LCD_DisplayStringLine(LCD_LINE_3, (uint8_t *)Pitch_Dis);
}
void Display_Roll()
{
	LCD_DisplayStringLine(LCD_LINE_4, (uint8_t *)Roll_Dis);
}
void Display_Alt()
{
	LCD_DisplayStringLine(LCD_LINE_5, (uint8_t *)Alt_Dis);
}
void Display_Tempr()
{
	LCD_DisplayStringLine(LCD_LINE_6, (uint8_t *)Tempr_Dis);
}
void Display_Press()
{
	LCD_DisplayStringLine(LCD_LINE_7, (uint8_t *)Press_Dis);
}


void Display_Yaw_F()
{
	LCD_DisplayStringLine(LCD_LINE_2, (uint8_t *)F);
}
void Display_Pitch_F()
{
	LCD_DisplayStringLine(LCD_LINE_3, (uint8_t *)F);
}
void Display_Roll_F()
{
	LCD_DisplayStringLine(LCD_LINE_4, (uint8_t *)F);
}

void Display_Example(uint16_t Line)
{
	uint16_t num = 0;
  for(num=0; num<4; num++)
  {
		LCD_DrawChinaChar(Line, num*24+40, (uint8_t *)Example[num]);
  }
}

void Display_En_Example()
{
	LCD_DisplayStringLine(LCD_LINE_4, (uint8_t *)En_Example);
}

void Display_Point_float()
{
	LCD_DisplayStringLine(LCD_LINE_5, (uint8_t *)Point_float);
}

void Display_Point_float2()
{
	LCD_DisplayStringLine(LCD_LINE_6, (uint8_t *)Point_float);
}

int Calculate_Bit(int Num)
{
	int Bit_Temp = 0;
	while((int)(Num/10) != 0 )
	{
		Bit_Temp++;
		Num = Num/10;
	}
	return (Bit_Temp+1);
}

void Display_Num_Int(int Num,int xpos,int ypos)//��ʾ����
{
	int Bit_Temp;
	int i;
	int Num_Int[10];
	int Temp = 1;
	Bit_Temp = Calculate_Bit(Num);
	for(i = 0;i<Bit_Temp-1;i++)
	{
		Temp = Temp * 10;
	}
	for(i = 0;i<Bit_Temp;i++)
	{
		Num_Int[i] = Num/Temp;
		Num = Num - Num_Int[i]*Temp;
		Temp = Temp/10;
		if(Num_Int[i] == 0)
		LCD_DisplayString(xpos,ypos,(uint8_t *)Num0);
		else if(Num_Int[i] == 1)
		LCD_DisplayString(xpos,ypos,(uint8_t *)Num1);
		else if(Num_Int[i] == 2)
		LCD_DisplayString(xpos,ypos,(uint8_t *)Num2);
		else if(Num_Int[i] == 3)
		LCD_DisplayString(xpos,ypos,(uint8_t *)Num3);
		else if(Num_Int[i] == 4)
		LCD_DisplayString(xpos,ypos,(uint8_t *)Num4);
		else if(Num_Int[i] == 5)
		LCD_DisplayString(xpos,ypos,(uint8_t *)Num5);
		else if(Num_Int[i] == 6)
		LCD_DisplayString(xpos,ypos,(uint8_t *)Num6);
		else if(Num_Int[i] == 7)
		LCD_DisplayString(xpos,ypos,(uint8_t *)Num7);
		else if(Num_Int[i] == 8)
		LCD_DisplayString(xpos,ypos,(uint8_t *)Num8);
		else if(Num_Int[i] == 9)
		LCD_DisplayString(xpos,ypos,(uint8_t *)Num9);			
		ypos = ypos + 15;
	}
}