//神舟开发板
#include "spi.h"
#include "stm32f4xx.h"
#include "Delay.h"
#define SetNCS  {GPIO_SetBits(GPIOB,GPIO_Pin_2);}//Periph_BB((uint32_t)&GPIOB->ODR, 2) = 1;
#define ClrNCS  {GPIO_ResetBits(GPIOB,GPIO_Pin_2);}//Periph_BB((uint32_t)&GPIOB->ODR, 2) = 0;
const unsigned char optical_rom[1986]={
0xe6,0xff,0x40,0x22,0x86,0xaa,0x9f,0x73,0xdc,0x34,0x5f,0x1d,0x0d,0x05,0xe2,0xae,
0x5c,0xe7,0x5e,0x67,0x2f,0xd2,0x45,0xaa,0xb7,0x2d,0xf9,0x71,0xc0,0xe2,0x89,0x8f,
0x18,0xc0,0x50,0xb1,0x4c,0x5b,0x1e,0xb3,0x53,0x32,0x56,0x3a,0x14,0xe7,0x64,0x58,
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0x00,0x88};


u8 tp=0,tpx=0,tpy=0,tp1=0;
u8 pict[900];
int ct=0;
int illill;


//串行外设接口SPI的初始化，SPI配置成主模式							  
//本例程选用SPI1对NRF24L01进行读写操作，先对SPI2进行初始化
void SPI2_Init(void)
{
  SPI_InitTypeDef  SPI_InitStructure;
  GPIO_InitTypeDef GPIO_InitStructure;
  
  /* Enable SPI2 and GPIO clocks */
  RCC_AHB1PeriphClockCmd(RCC_SPI2, ENABLE);

  /*!< SPI Periph clock enable */
  RCC_APB1PeriphClockCmd(RCC_SPI2_CLK, ENABLE);

  GPIO_PinAFConfig(SPI2_GPIO_PORT, SPI2_SCK_SOURCE, GPIO_AF_SPI2);
  GPIO_PinAFConfig(SPI2_GPIO_PORT, SPI2_MISO_SOURCE, GPIO_AF_SPI2);
  GPIO_PinAFConfig(SPI2_GPIO_PORT, SPI2_MOSI_SOURCE, GPIO_AF_SPI2);
      
  /*!< Configure  pins: SCK */
		GPIO_InitStructure.GPIO_Pin = GPIO_Pin_2;
    GPIO_InitStructure.GPIO_Speed = GPIO_Speed_50MHz;
    GPIO_InitStructure.GPIO_Mode = GPIO_Mode_OUT;
	  GPIO_InitStructure.GPIO_OType = GPIO_OType_PP; 
	  GPIO_InitStructure.GPIO_PuPd = GPIO_PuPd_NOPULL; 
    GPIO_Init(GPIOB, &GPIO_InitStructure);
	
	
//	
//	GPIO_InitStructure.GPIO_Pin = GPIO_Pin_13 | GPIO_Pin_14| GPIO_Pin_15;
//  GPIO_InitStructure.GPIO_Speed = GPIO_Speed_50MHz;
//  GPIO_InitStructure.GPIO_Mode = GPIO_Mode_AF;	//复用推挽输出
//  GPIO_InitStructure.GPIO_OType = GPIO_OType_PP;
//	GPIO_Init(GPIOB, &GPIO_InitStructure);


	
  /*!< Configure  pins: SCK */
  GPIO_InitStructure.GPIO_Pin = SPI2_SCK;
  GPIO_InitStructure.GPIO_Mode = GPIO_Mode_AF;
  GPIO_InitStructure.GPIO_Speed = GPIO_Speed_100MHz;
  GPIO_InitStructure.GPIO_OType = GPIO_OType_PP;
  GPIO_InitStructure.GPIO_PuPd  = GPIO_PuPd_UP;//GPIO_PuPd_NOPULL;
  GPIO_Init(SPI2_GPIO_PORT, &GPIO_InitStructure);

  /*!< Configure  pins: MISO */
  GPIO_InitStructure.GPIO_Pin = SPI2_MISO;
  GPIO_InitStructure.GPIO_Mode = GPIO_Mode_AF;	//复用推挽输出
  GPIO_InitStructure.GPIO_OType = GPIO_OType_PP;
	GPIO_InitStructure.GPIO_PuPd = GPIO_PuPd_NOPULL; 
  GPIO_Init(SPI2_GPIO_PORT, &GPIO_InitStructure);

  /*!< Configure  pins: MOSI */
  GPIO_InitStructure.GPIO_Pin = SPI2_MOSI;
  GPIO_Init(SPI2_GPIO_PORT, &GPIO_InitStructure);






 SPI_Cmd(SPI2, DISABLE);
  /* SPI1 configuration *///初始化SPI1结构体
  SPI_InitStructure.SPI_Direction = SPI_Direction_2Lines_FullDuplex;  //SPI1设置为两线全双工
  SPI_InitStructure.SPI_Mode = SPI_Mode_Master; //设置SPI1为主模式
  SPI_InitStructure.SPI_DataSize = SPI_DataSize_8b; //SPI发送接收8位帧结构
  SPI_InitStructure.SPI_CPOL = SPI_CPOL_High; //串行时钟在不操作时，时钟为低电平
  SPI_InitStructure.SPI_CPHA = SPI_CPHA_2Edge; //第一个时钟沿开始采样数据
  SPI_InitStructure.SPI_NSS = SPI_NSS_Soft; //NSS信号由软件（使用SSI位）管理
  SPI_InitStructure.SPI_BaudRatePrescaler = SPI_BaudRatePrescaler_16; //SPI波特率预分频值为8
  SPI_InitStructure.SPI_FirstBit = SPI_FirstBit_MSB; //数据传输从MSB位开始
  SPI_InitStructure.SPI_CRCPolynomial = 7; //CRC值计算的多项式
  SPI_Init(SPI2, &SPI_InitStructure);  //根据SPI_InitStruct中指定的参数初始化外设SPI2寄存器
  
  /* Enable SPI2  *///使能SPI2外设
  SPI_Cmd(SPI2, ENABLE);
   SPI_I2S_ClearITPendingBit(SPI2, SPI_I2S_IT_RXNE); 
  SPI2_ReadWriteByte(0xff);                        //启动传输	

}
	

u8 SPI2_ReadWriteByte(u8 TxData)                                        //SPI读写数据函数
{		
	u8 retry=0;				 	
	/* Loop while DR register in not emplty */
	while (SPI_I2S_GetFlagStatus(SPI2, SPI_I2S_FLAG_TXE) == RESET)      //发送缓存标志位为空
		{
		retry++;
		if(retry>200)return 0;
		}			  
	/* Send byte through the SPI1 peripheral */
	SPI_I2S_SendData(SPI2, TxData);                                    //通过外设SPI1发送一个数据
	retry=0;
	/* Wait to receive a byte */
	while (SPI_I2S_GetFlagStatus(SPI2, SPI_I2S_FLAG_RXNE) == RESET);   //接收缓存标志位不为空
		{
		retry++;
		if(retry>200)return 0;
		}	  						    
	/* Return the byte read from the SPI bus */
	return SPI_I2S_ReceiveData(SPI2);                                 //通过SPI1返回接收数据				    
}


void optical_write(u8 add,u8 data)
{
	ClrNCS;
	Delay_Us(80);
	SPI2_ReadWriteByte(add+0x80);
	Delay_Us(80);
	SPI2_ReadWriteByte(data);
	Delay_Us(80);
	SetNCS;
}

u8 optical_read(u8 add)
{
	tp=0;
	ClrNCS;
	Delay_Us(80);
	tp=SPI2_ReadWriteByte(add);
	Delay_Us(80);
	tp=SPI2_ReadWriteByte(0xff);
	Delay_Us(80);
	SetNCS;
	return tp;
}

void optical_init()
{
	SPI2_Init();
	ClrNCS;
	optical_write(0x20,0x44);
	Delay_Us(80);
	optical_write(0x23,0x07);
	Delay_Us(80);
	optical_write(0x24,0x88);
	Delay_Us(80);
	SetNCS;
	Delay_Us(340);
	ClrNCS;
	optical_write(opt_srom,0x18);
	SetNCS;
	Delay_Us(41);
	ClrNCS;
	for(illill=0;illill<=1985;illill++)
	{
		optical_write(opt_load,optical_rom[illill]);
		Delay_Us(80);
	}
	SetNCS;
		optical_write(opt_motclr,0xff);
	Delay_Us(80);
	optical_write(opt_cfg,0x10);/////00
	Delay_Us(80);
	optical_write(opt_extcfg,0x01);
	Delay_Us(80);
	optical_write(opt_shut_max_low,0x00);
	Delay_Us(80);
	optical_write(opt_shut_max_up,0x42);//2f
	Delay_Us(80);
	optical_write(opt_frame_max_low,0xc0);//3e80 *2500=40m  9c40*1000=40m  5dc0->24000
	Delay_Us(80);
	optical_write(opt_frame_max_up,0x5d);
	Delay_Us(80);

}

int optical_pixel()
{
	tp1=0;
	ct=0;
	optical_write(opt_cap,0x83);
	Delay_Ms(5);
	for(illill=0;illill<1940;illill++)
	{
		tp1=optical_read(opt_cap);
		if(tp1>0)
		{
			ct++;
			if(illill<900)
					pict[illill]=tp1;
		}
	}
	SetNCS;
	Delay_Us(80);
	return ct;
}
















